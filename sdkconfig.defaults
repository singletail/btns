## sdkconfig.defaults
```kconfig
# Longboi s3

# CONFIG_IDF_TARGET="esp32s3"
# CONFIG_IDF_TARGET_ESP32S3=y
# CONFIG_ESP_DEFAULT_CPU_FREQ_MHZ_240=y
# CONFIG_ESP_DEFAULT_CPU_FREQ_MHZ=240
# CONFIG_ESPTOOLPY_FLASHSIZE_8MB=y
# CONFIG_ESPTOOLPY_FLASHSIZE="8MB"
# CONFIG_LWIP_LOCAL_HOSTNAME="Longboi"

# T-Display s3

# CONFIG_IDF_TARGET="esp32s3"
# CONFIG_IDF_TARGET_ESP32S3=y
# CONFIG_ESP_DEFAULT_CPU_FREQ_MHZ_240=y
# CONFIG_ESP_DEFAULT_CPU_FREQ_MHZ=240
# CONFIG_ESPTOOLPY_FLASHSIZE_16MB=y
# CONFIG_ESPTOOLPY_FLASHSIZE="16MB"
# CONFIG_LWIP_LOCAL_HOSTNAME="tdisplay-s3"

# Xiao s3

# CONFIG_IDF_TARGET="esp32s3"
# CONFIG_IDF_TARGET_ESP32S3=y
# CONFIG_ESP_DEFAULT_CPU_FREQ_MHZ_240=y
# CONFIG_ESP_DEFAULT_CPU_FREQ_MHZ=240
# CONFIG_ESPTOOLPY_FLASHSIZE_8MB=y
# CONFIG_ESPTOOLPY_FLASHSIZE="8MB"
# CONFIG_LWIP_LOCAL_HOSTNAME="Xiao s3"

# Xiao c6

# CONFIG_IDF_TARGET="esp32c6"
# CONFIG_IDF_TARGET_ESP32C6=y
# CONFIG_ESP_DEFAULT_CPU_FREQ_MHZ_160=y
# CONFIG_ESP_DEFAULT_CPU_FREQ_MHZ=160
# CONFIG_ESPTOOLPY_FLASHSIZE_4MB=y
# CONFIG_ESPTOOLPY_FLASHSIZE="4MB"
# CONFIG_LWIP_LOCAL_HOSTNAME="Xiao c6"

# Zero s3

CONFIG_IDF_TARGET="esp32s3"
CONFIG_IDF_TARGET_ESP32S3=y
CONFIG_ESP_DEFAULT_CPU_FREQ_MHZ_240=y
CONFIG_ESP_DEFAULT_CPU_FREQ_MHZ=240
CONFIG_ESPTOOLPY_FLASHSIZE_4MB=y
CONFIG_ESPTOOLPY_FLASHSIZE="4MB"
CONFIG_LWIP_LOCAL_HOSTNAME="Zero s3"

# DMA
CONFIG_RMT_ISR_IRAM_SAFE=y
CONFIG_RMT_ENABLE_DEBUG_LOG=n

# LWIP
CONFIG_LWIP_IPV6=n
CONFIG_LWIP_DEBUG=n
CONFIG_LWIP_ESP_GRATUITOUS_ARP=n
CONFIG_LWIP_DHCP_DOES_ARP_CHECK=n

#WiFi
CONFIG_ESP_WIFI_DEBUG_PRINT=n
CONFIG_ESP_WIFI_ENABLE_WPA3_SAE=n
CONFIG_ESP_WIFI_ENABLE_WPA3_OWE_STA=n
CONFIG_ESP_WIFI_SOFTAP_SUPPORT=n
CONFIG_ESP_WIFI_ENTERPRISE_SUPPORT=n

# MQTT
CONFIG_MQTT_PROTOCOL_5=y

# Logging
CONFIG_LOG_DEFAULT_LEVEL_WARN=y
CONFIG_LOG_DEFAULT_LEVEL=2
CONFIG_LOG_MAXIMUM_LEVEL=2

# Flash Mode
CONFIG_ESPTOOLPY_FLASH_MODE_AUTO_DETECT=n
CONFIG_ESPTOOLPY_FLASHMODE_QIO=y
CONFIG_ESPTOOLPY_FLASHMODE="qio"

# Flash Frequency
CONFIG_ESPTOOLPY_FLASHFREQ_80M=y
CONFIG_ESPTOOLPY_FLASHFREQ="80m"

# Flash Sample Mode
CONFIG_ESPTOOLPY_FLASH_SAMPLE_MODE_STR=y

# Monitor Baud
CONFIG_ESPTOOLPY_MONITOR_BAUD=921600
```
